## components/camera_driver/Kconfig
```kconfig
menu "Camera Driver"

    choice CAMERA_PIXEL_FORMAT
        prompt "Pixel format"
        default CAMERA_PIXEL_FORMAT_JPEG
        help
            Output pixel format of the camera.

        config CAMERA_PIXEL_FORMAT_JPEG
            bool "JPEG"
        config CAMERA_PIXEL_FORMAT_RGB565
            bool "RGB565"
        config CAMERA_PIXEL_FORMAT_GRAYSCALE
            bool "Grayscale"
    endchoice

    choice CAMERA_FRAME_SIZE
        prompt "Frame size"
        default CAMERA_FRAME_SIZE_VGA
        help
            Resolution of captured images.

        config CAMERA_FRAME_SIZE_96X96
            bool "96x96"
        config CAMERA_FRAME_SIZE_QVGA
            bool "QVGA (320x240)"
        config CAMERA_FRAME_SIZE_VGA
            bool "VGA (640x480)"
        config CAMERA_FRAME_SIZE_SVGA
            bool "SVGA (800x600)"
        config CAMERA_FRAME_SIZE_XGA
            bool "XGA (1024x768)"
        config CAMERA_FRAME_SIZE_SXGA
            bool "SXGA (1280x1024)"
        config CAMERA_FRAME_SIZE_UXGA
            bool "UXGA (1600x1200)"
    endchoice

    config CAMERA_JPEG_QUALITY
        int "JPEG quality (0-63, lower is better)"
        default 12
        range 0 63
        depends on CAMERA_PIXEL_FORMAT_JPEG
        help
            JPEG compression quality. Lower values produce higher quality
            images but larger file sizes.

endmenu
```

## main/Kconfig.projbuild
```kconfig
menu "App Configuration"

    config CAPTURE_INTERVAL_MS
        int "Capture interval (ms)"
        default 5000
        range 1000 3600000
        help
            Interval between image captures in milliseconds.

endmenu
```

## sdkconfig.defaults
```kconfig
# コンパイラ警告を強化
CONFIG_COMPILER_WARN_WRITE_STRINGS=y

# スタックオーバーフロー検出（カナリア方式）
CONFIG_FREERTOS_CHECK_STACKOVERFLOW_CANARY=y

# C++例外・RTTIを無効化（メモリ節約）
CONFIG_COMPILER_CXX_EXCEPTIONS=n
CONFIG_COMPILER_CXX_RTTI=n

# printfの浮動小数点サポートを無効化（コードサイズ削減）
CONFIG_NEWLIB_NANO_FORMAT=y
```
